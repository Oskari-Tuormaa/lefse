## CMakeLists.txt
```
cmake_minimum_required(VERSION 3.20)

find_package(Zephyr REQUIRED HINTS $ENV{ZEPHYR_BASE})
project(uart_echo)

target_sources(app PRIVATE src/main.cpp)
target_include_directories(app PRIVATE include)

if(CONFIG_UART_ASYNC_API AND CONFIG_UART_INTERRUPT_DRIVEN)
    message(FATAL_ERROR "Both async and interrupt UART API's chosen at once. Please choose either one or none.")
elseif(CONFIG_UART_ASYNC_API)
    target_sources(app PRIVATE ./src/uart_async.cpp)
elseif(CONFIG_UART_INTERRUPT_DRIVEN)
    target_sources(app PRIVATE ./src/uart_interrupt.cpp)
else()
    target_sources(app PRIVATE ./src/uart_polling.cpp)
endif()
```

## prj.conf
```kconfig
CONFIG_LOG=y

CONFIG_SERIAL=y
# CONFIG_UART_INTERRUPT_DRIVEN=y
CONFIG_UART_ASYNC_API=y

CONFIG_CPP=y
CONFIG_STD_CPP20=y
CONFIG_REQUIRES_FULL_LIBCPP=y
```

## src/main.cpp
```c
extern int setup_uart();
extern void run_uart();

int main()
{
    if (setup_uart() < 0)
        return 0;
    run_uart();
}
```

## src/uart_async.cpp
```c
#include <array>
#include <lefse/uart.hpp>
#include <zephyr/kernel.h>
#include <zephyr/logging/log.h>

LOG_MODULE_REGISTER(uart_async);

lefse::uart             uart { DEVICE_DT_GET(DT_NODELABEL(uart0)) };
std::array<uint8_t, 64> buf;

template <typename... Ts>
struct overload : Ts...
{
    using Ts::operator()...;
};

#define CHECK_ERR(check, ...) \
    if (check)                \
    {                         \
        LOG_ERR(__VA_ARGS__); \
        return err;           \
    }

int setup_uart()
{
    int err;

    if (!uart.is_ready())
    {
        LOG_ERR("Device %s was not ready", uart.name());
        return -1;
    }

    err = uart.configure(115200);
    CHECK_ERR(err < 0, "Failed to configure device %s [%d]", uart.name(), err);

    err = uart.set_async_callback(
        [](auto evt)
        {
            using namespace lefse::async_events;
            auto evt_handler = overload { [](rx_buf_request)
                                          {
                                              uart.rx_buf_rsp(buf);
                                          },
                                          [](rx_ready evt)
                                          {
                                              uart.write(evt.span);
                                          },
                                          [](auto) {} };
            std::visit(evt_handler, evt);
        });
    CHECK_ERR(err < 0,
              "Failed setting rx interrupt callback on device %s [%d]",
              uart.name(),
              err);

    err = uart.rx_enable(buf, USEC_PER_MSEC);
    CHECK_ERR(err < 0,
              "Failed enabling receiving data on device %s [%d]",
              uart.name(),
              err);

    return 0;
}

void run_uart()
{
}
```

## src/uart_interrupt.cpp
```c
#include <lefse/uart.hpp>
#include <zephyr/kernel.h>
#include <zephyr/logging/log.h>

LOG_MODULE_REGISTER(uart_interrupt);

lefse::uart uart { DEVICE_DT_GET(DT_NODELABEL(uart0)) };

#define CHECK_ERR(check, ...) \
    if (check)                \
    {                         \
        LOG_ERR(__VA_ARGS__); \
        return err;           \
    }

int setup_uart()
{
    int err;

    if (!uart.is_ready())
    {
        LOG_ERR("Device %s was not ready", uart.name());
        return -1;
    }

    err = uart.configure(115200);
    CHECK_ERR(err < 0, "Failed configuring device %s [%d]", uart.name(), err);

    err = uart.set_rx_interrupt_callback(
        []
        {
            uint8_t ch;
            while (uart.fifo_read(&ch) != 0)
            {
                uart.write(ch);
            }
        });
    CHECK_ERR(err < 0,
              "Failed setting rx interrupt callback on device %s [%d]",
              uart.name(),
              err);

    uart.irq_rx_enable();

    return 0;
}

void run_uart()
{
}
```

## src/uart_polling.cpp
```c
#include <lefse/uart.hpp>
#include <zephyr/kernel.h>
#include <zephyr/logging/log.h>

LOG_MODULE_REGISTER(uart_polling);

lefse::uart uart { DEVICE_DT_GET(DT_NODELABEL(uart0)) };

int setup_uart()
{
    int err;

    if (!uart.is_ready())
    {
        LOG_ERR("Uart %s was not ready", uart.name());
        return -1;
    }

    err = uart.configure(115200);
    if (err < 0)
    {
        LOG_ERR("Failed configuring device %s [%d]", uart.name(), err);
        return err;
    }

    return 0;
}

void run_uart()
{
    uint8_t ch;
    while (true)
    {
        while (uart.read(&ch) == 0)
        {
            uart.write(ch);
        }

        k_sleep(K_MSEC(1));
    }
}
```
